// SPDX-License-Identifier: GPL-2.0-only
// Migrate only the reset pad's providers. The packager isolates storage probing.
/dts-v1/;
/plugin/;

&pdc {
    compatible = "qcom,sm8250-pdc", "qcom,pdc";
};

&tlmm {
    compatible = "qcom,sm8250-pinctrl";
    // The OEM /soc parent has one address cell and one size cell.
    reg = <0x0f100000 0x300000>, <0x0f500000 0x300000>, <0x0f900000 0x300000>;
    reg-names = "west", "south", "north";
    gpio-ranges = <&tlmm 0 0 181>;
};

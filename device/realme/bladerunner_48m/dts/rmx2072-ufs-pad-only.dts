// SPDX-License-Identifier: GPL-2.0-only
// Register a diagnostic TLMM provider without moving the OEM GPIO consumers.
/dts-v1/;
/plugin/;

&{/soc} {
    #address-cells = <1>;
    #size-cells = <1>;

    pinctrl@f100000 {
        // Bind sm8250-pinctrl explicitly from the diagnostic shell after USB starts.
        compatible = "realme,rmx2072-diag-tlmm";
        reg = <0x0f100000 0x300000>, <0x0f500000 0x300000>, <0x0f900000 0x300000>;
        reg-names = "west", "south", "north";
        interrupts = <0 208 4>;
        gpio-controller;
        #gpio-cells = <2>;
        interrupt-controller;
        #interrupt-cells = <2>;
        // With no gpio-ranges, this driver adds a linear pin range itself.
        // This isolated run uses the GIC IRQ without a PDC wake domain.
    };
};

// SPDX-License-Identifier: GPL-2.0-only
// Apply after the known-good SID0 USB tree and before the original OEM DTBO.
/dts-v1/;
/plugin/;

&wdog {
    compatible = "qcom,apss-wdt-sm8250", "qcom,kpss-wdt";
    clocks = <&diag_sleep>;
    interrupts = <0 0 1>; // GIC_SPI 0 IRQ_TYPE_EDGE_RISING
};

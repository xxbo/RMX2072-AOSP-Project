## device/realme/bladerunner_48m/bootstrap/sm8250_defconfig
```kconfig
# SPDX-License-Identifier: GPL-2.0-only
# Early-boot platform drivers are built in for the handset's boot-v2 layout.
CONFIG_ARCH_QCOM=y
CONFIG_PINCTRL_MSM=y
CONFIG_PINCTRL_SM8250=y
CONFIG_PINCTRL_QCOM_SPMI_PMIC=y
CONFIG_COMMON_CLK_QCOM=y
CONFIG_SM_GCC_8250=y
CONFIG_SM_DISPCC_8250=y
CONFIG_SM_GPUCC_8250=y
CONFIG_QCOM_CLK_RPMH=y
CONFIG_QCOM_COMMAND_DB=y
CONFIG_QCOM_RPMH=y
CONFIG_QCOM_RPMHPD=y
CONFIG_QCOM_SMEM=y
CONFIG_HWSPINLOCK=y
CONFIG_HWSPINLOCK_QCOM=y
CONFIG_QCOM_SCM=y
CONFIG_QCOM_AOSS_QMP=y
CONFIG_QCOM_PDC=y
CONFIG_SPMI=y
CONFIG_SPMI_MSM_PMIC_ARB=y
CONFIG_MFD_SPMI_PMIC=y
CONFIG_REGULATOR_QCOM_RPMH=y
CONFIG_REGULATOR_QCOM_SPMI=y
CONFIG_NVMEM_QCOM_QFPROM=y
CONFIG_INTERCONNECT=y
CONFIG_INTERCONNECT_QCOM=y
CONFIG_INTERCONNECT_QCOM_SM8250=y
CONFIG_INTERCONNECT_QCOM_OSM_L3=y
CONFIG_ARM_SMMU=y
CONFIG_SCSI_UFS_QCOM=y
CONFIG_PHY_QCOM_QMP=y
CONFIG_PHY_QCOM_USB_SNPS_FEMTO_V2=y
CONFIG_USB_DWC3_QCOM=y
CONFIG_USB_DWC3=y
CONFIG_USB_GADGET=y
CONFIG_USB_CONFIGFS=y
CONFIG_USB_CONFIGFS_ACM=y
CONFIG_I2C_QCOM_GENI=y
CONFIG_SERIAL_QCOM_GENI=y
CONFIG_SERIAL_QCOM_GENI_CONSOLE=y
CONFIG_PSTORE=y
CONFIG_PSTORE_RAM=y
CONFIG_PSTORE_CONSOLE=y
CONFIG_PSTORE_PMSG=y
# Adopt an APSS watchdog left running by firmware; keep a usable reset handler.
CONFIG_WATCHDOG=y
CONFIG_WATCHDOG_HANDLE_BOOT_ENABLED=y
CONFIG_QCOM_WDT=y
CONFIG_IKCONFIG=y
CONFIG_IKCONFIG_PROC=y
```
